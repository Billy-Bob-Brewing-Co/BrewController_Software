## main/Kconfig.projbuild
```kconfig
menu "Brew Controller Configuration"

    config ESP_WIFI_SSID
        string "WiFi SSID"
        default "myssid"
        help
            SSID (network name) for the example to connect to.
    config ESP_WIFI_PASSWORD
        string "WiFi Password"
        default "mypassword"
        help
            WiFi password (WPA or WPA2) for the example to use.
    config ESP_MAXIMUM_RETRY
        int "Maximum retry"
        default 5
        help
            Set the Maximum retry to avoid station reconnecting to the AP unlimited when the AP is really inexistent.
    config BEER_TEMP_SETPOINT
        int "Beer Temperature Setpoint"
        range 5 30
        default 20
        help
            Set the target setpoint for the controller to attempt to get the beer temp too.
    config LOG_PERIOD
        int "Log Period"
        range 0 60
        default 16
        help
            Set the period to log data in minutes.
    config WEBHOOK_URL
        string "Webhook URL"
        default "http://log.brewfather.net/stream?id=<custom-id>"
        help
            URL for brewfather custom stream webook.
    config DEVICE_NAME
        string "Device Name"
        default "Brew Controller"
        help
            Name used to log the result.

endmenu
```
